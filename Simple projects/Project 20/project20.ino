byte r[8] = {A0, A1, 11, A2, A3, A4, A5, 10}; // пины строк
byte c[8] = {2, 3, 4, 5, 6, 7, 8, 9};         // пины столбцов

byte m[8][8] = {              // кадр "крест"
  0, 0, 0, 1, 1, 0, 0, 0,
  0, 0, 0, 1, 1, 0, 0, 0,
  0, 0, 0, 1, 1, 0, 0, 0,
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  0, 0, 0, 1, 1, 0, 0, 0
};

byte y[8][8] = {             // кадр "рожица"
  0, 0, 0, 0, 0, 1, 1, 0,
  0, 1, 1, 0, 0, 1, 1, 0,
  0, 0, 0, 0, 0, 0, 0, 0,
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  0, 0, 1, 1, 1, 1, 0, 0
};

byte hf[8][8] = {             // полное сердце
  0, 0, 0, 0, 0, 0, 0, 0,
  0, 1, 1, 0, 0, 1, 1, 0,
  1, 1, 1, 1, 1, 1, 1, 1,
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  0, 0, 0, 1, 1, 0, 0, 0
};

byte he[8][8] = {             // пустое сердце
  0, 0, 0, 0, 0, 0, 0, 0,
  0, 0, 0, 0, 0, 0, 0, 0,
  0, 1, 1, 0, 0, 1, 1, 0,
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  0, 0, 0, 0, 0, 0, 0, 0
};

void setup() {
  for (byte i = 0; i < 8; i++) {  // инициализация пинов
    pinMode(r[i], OUTPUT);
    digitalWrite(r[i], LOW);
    pinMode(c[i], OUTPUT);
    digitalWrite(c[i], HIGH);
  }
}

void loop() {
  view();                      
}

int timerX = 0;
void view() {
  static unsigned long timer;
  static byte ii = 0;
  static byte ii_old = 0;
  if (timer > millis()) 
    return;   // не чаще 1 кадра в 1 мс

  digitalWrite(c[ii_old], HIGH);  // выключаем предыдущий активный столбец
  
  
  if (timerX < 200){
    for (byte i = 0; i < 8; i++) {  // выводим строки
      digitalWrite(r[i], hf[i][ii]);
    }
    timerX += 1;
  }
  else{
    for (byte i = 0; i < 8; i++) {  // выводим строки
      digitalWrite(r[i], he[i][ii]);
    }
    timerX += 1;
    if (timerX == 400){
      timerX = 0;
    }
  }
  
  digitalWrite(c[ii], LOW);       // включаем новый активный столбец до следующего входа в цункцию
  
  ii_old = ii;
  ii = ii == 7 ? 0 : ii + 1;
  timer = millis() + 1;
}